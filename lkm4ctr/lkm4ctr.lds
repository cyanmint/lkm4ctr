SECTIONS {
	__patchable_function_entries : { *(__patchable_function_entries) }
	.text : {
		lkm4ctr_log.cfi_jt = . + 0x37e80;
		lkm4ctr_diagfs_mount.cfi_jt = . + 0x37e88;
		lkm4ctr_diagfs_kill_sb.cfi_jt = . + 0x37e90;
		kill_litter_super.cfi_jt = . + 0x37e98;
		lkm4ctr_diagfs_fill_super.cfi_jt = . + 0x37ea0;
		lkm4ctr_diagfs_control_snprintf.cfi_jt = . + 0x37ea8;
		lkm4ctr_diagfs_status_snprintf.cfi_jt = . + 0x37eb0;
		lkm4ctr_diagfs_hooks_snprintf.cfi_jt = . + 0x37eb8;
		lkm4ctr_diagfs_namespaces_snprintf.cfi_jt = . + 0x37ec0;
		lkm4ctr_diagfs_log_snprintf.cfi_jt = . + 0x37ec8;
		lkm4ctr_diagfs_global_resources_snprintf.cfi_jt = . + 0x37ed0;
		lkm4ctr_diagfs_mqueue_msg_snprintf.cfi_jt = . + 0x37ed8;
		lkm4ctr_diagfs_sysvipc_resources_snprintf.cfi_jt = . + 0x37ee0;
		lkm4ctr_diagfs_references_snprintf.cfi_jt = . + 0x37ee8;
		lkm4ctr_diagfs_hotreload_status_snprintf.cfi_jt = . + 0x37ef0;
		lkm4ctr_diagfs_hotreload_trigger_snprintf.cfi_jt = . + 0x37ef8;
		lkm4ctr_diagfs_helper_script_snprintf.cfi_jt = . + 0x37f00;
		lkm4ctr_diagfs_readme_snprintf.cfi_jt = . + 0x37f08;
		lkm4ctr_diagfs_drop_inode.cfi_jt = . + 0x37f10;
		simple_statfs.cfi_jt = . + 0x37f18;
		lkm4ctr_safe_unload_fn.cfi_jt = . + 0x37f20;
		lkm4ctr_hotreload_worker.cfi_jt = . + 0x37f28;
		shadow_hook_resolve.cfi_jt = . + 0x37f30;
		shadow_hook_remove_all.cfi_jt = . + 0x37f38;
		shadow_hook_remove.cfi_jt = . + 0x37f40;
		shadow_hook_registry_tag_active.cfi_jt = . + 0x37f48;
		lkm4ctr_log_snprintf.cfi_jt = . + 0x37f50;
		shadow_hook_registry_snprintf.cfi_jt = . + 0x37f58;
		shadow_hook_registry_set_active.cfi_jt = . + 0x37f60;
		shadow_hook_install_all.cfi_jt = . + 0x37f68;
		shadow_hook_install.cfi_jt = . + 0x37f70;
		shadow_hook_retprobe_ret.cfi_jt = . + 0x37f78;
		shadow_hook_quiesce.cfi_jt = . + 0x37f80;
		shadow_hook_is_quiescing.cfi_jt = . + 0x37f88;
		lkm4ctr_diagfs_control_write.cfi_jt = . + 0x37f90;
		lkm4ctr_diagfs_hotreload_trigger_write.cfi_jt = . + 0x37f98;
		shadow_setgroups_write.cfi_jt = . + 0x37fa0;
		shadow_ns_type_simulated.cfi_jt = . + 0x37fa8;
		shadow_ns_type_real.cfi_jt = . + 0x37fb0;
		delayed_work_timer_fn.cfi_jt = . + 0x37fb8;
		shadow_ns_diag_snprintf_type.cfi_jt = . + 0x37fc0;
		shadow_ns_diag_snprintf.cfi_jt = . + 0x37fc8;
		seq_lseek.cfi_jt = . + 0x37fd0;
		default_llseek.cfi_jt = . + 0x37fd8;
		noop_llseek.cfi_jt = . + 0x37fe0;
		shadow_hook_pre_handler.cfi_jt = . + 0x37fe8;
		vns_exit_kprobe_pre_handler.cfi_jt = . + 0x37ff0;
		pidns_get_parent.cfi_jt = . + 0x37ff8;
		vns_ns_get_owner.cfi_jt = . + 0x38000;
		cmp_map_id.cfi_jt = . + 0x38008;
		cmp_extents_forward.cfi_jt = . + 0x38010;
		cmp_extents_reverse.cfi_jt = . + 0x38018;
		uid_m_start.cfi_jt = . + 0x38020;
		gid_m_start.cfi_jt = . + 0x38028;
		projid_m_start.cfi_jt = . + 0x38030;
		sysvipc_proc_start.cfi_jt = . + 0x38038;
		m_stop.cfi_jt = . + 0x38040;
		sysvipc_proc_stop.cfi_jt = . + 0x38048;
		m_next.cfi_jt = . + 0x38050;
		sysvipc_proc_next.cfi_jt = . + 0x38058;
		do_msg_fill.cfi_jt = . + 0x38060;
		compat_do_msg_fill.cfi_jt = . + 0x38068;
		lkm4ctr_diagfs_show.cfi_jt = . + 0x38070;
		uid_m_show.cfi_jt = . + 0x38078;
		gid_m_show.cfi_jt = . + 0x38080;
		projid_m_show.cfi_jt = . + 0x38088;
		sysvipc_proc_show.cfi_jt = . + 0x38090;
		sysvipc_msg_proc_show.cfi_jt = . + 0x38098;
		sysvipc_sem_proc_show.cfi_jt = . + 0x380a0;
		sysvipc_shm_proc_show.cfi_jt = . + 0x380a8;
		shm_try_destroy_orphaned.cfi_jt = . + 0x380b0;
		delayed_free_pidns.cfi_jt = . + 0x380b8;
		msg_rcu_free.cfi_jt = . + 0x380c0;
		sem_rcu_free.cfi_jt = . + 0x380c8;
		shm_rcu_free.cfi_jt = . + 0x380d0;
		shm_mmap.cfi_jt = . + 0x380d8;
		lkm4ctr_diagfs_open.cfi_jt = . + 0x380e0;
		single_release.cfi_jt = . + 0x380e8;
		shadow_ns_nsfd_open.cfi_jt = . + 0x380f0;
		shadow_setgroups_open.cfi_jt = . + 0x380f8;
		shadow_mq_anon_release.cfi_jt = . + 0x38100;
		shadow_blkdev_open.cfi_jt = . + 0x38108;
		shadow_chrdev_open.cfi_jt = . + 0x38110;
		sysvipc_proc_open.cfi_jt = . + 0x38118;
		sysvipc_proc_release.cfi_jt = . + 0x38120;
		shm_release.cfi_jt = . + 0x38128;
		shm_fsync.cfi_jt = . + 0x38130;
		shm_get_unmapped_area.cfi_jt = . + 0x38138;
		shm_fallocate.cfi_jt = . + 0x38140;
		shm_open.cfi_jt = . + 0x38148;
		shm_close.cfi_jt = . + 0x38150;
		shm_fault.cfi_jt = . + 0x38158;
		shm_pagesize.cfi_jt = . + 0x38160;
		newque.cfi_jt = . + 0x38168;
		newary.cfi_jt = . + 0x38170;
		newseg.cfi_jt = . + 0x38178;
		sem_more_checks.cfi_jt = . + 0x38180;
		shm_more_checks.cfi_jt = . + 0x38188;
		shadow_ns_reap_workfn.cfi_jt = . + 0x38190;
		vns_nsproxy_deferred_put_fn.cfi_jt = . + 0x38198;
		free_user_ns.cfi_jt = . + 0x381a0;
		free_ipc.cfi_jt = . + 0x381a8;
		vns_sysvsem_exit_work.cfi_jt = . + 0x381b0;
		vns_sysvshm_exit_work.cfi_jt = . + 0x381b8;
		mqueue_create_attr.cfi_jt = . + 0x381c0;
		simple_lookup.cfi_jt = . + 0x381c8;
		mqueue_create.cfi_jt = . + 0x381d0;
		mqueue_unlink.cfi_jt = . + 0x381d8;
		seq_read.cfi_jt = . + 0x381e0;
		shadow_setgroups_read.cfi_jt = . + 0x381e8;
		mqueue_read_file.cfi_jt = . + 0x381f0;
		mqueue_poll_file.cfi_jt = . + 0x381f8;
		mqueue_flush_file.cfi_jt = . + 0x38200;
		mqueue_fs_context_free.cfi_jt = . + 0x38208;
		mqueue_init_fs_context.cfi_jt = . + 0x38210;
		mqueue_get_tree.cfi_jt = . + 0x38218;
		mqueue_fill_super.cfi_jt = . + 0x38220;
		mqueue_alloc_inode.cfi_jt = . + 0x38228;
		lkm4ctr_diagfs_evict_inode.cfi_jt = . + 0x38230;
		mqueue_free_inode.cfi_jt = . + 0x38238;
		mqueue_evict_inode.cfi_jt = . + 0x38240;
		init_once.cfi_jt = . + 0x38248;
		security_msg_queue_associate.cfi_jt = . + 0x38250;
		security_sem_associate.cfi_jt = . + 0x38258;
		security_shm_associate.cfi_jt = . + 0x38260;
		utsns_put.cfi_jt = . + 0x38268;
		pidns_put.cfi_jt = . + 0x38270;
		userns_put.cfi_jt = . + 0x38278;
		ipcns_put.cfi_jt = . + 0x38280;
		vns_cgroupns_put.cfi_jt = . + 0x38288;
		vns_timens_put.cfi_jt = . + 0x38290;
		utsns_install.cfi_jt = . + 0x38298;
		pidns_install.cfi_jt = . + 0x382a0;
		userns_install.cfi_jt = . + 0x382a8;
		ipcns_install.cfi_jt = . + 0x382b0;
		vns_cgroupns_install.cfi_jt = . + 0x382b8;
		vns_timens_install.cfi_jt = . + 0x382c0;
		utsns_owner.cfi_jt = . + 0x382c8;
		pidns_owner.cfi_jt = . + 0x382d0;
		userns_owner.cfi_jt = . + 0x382d8;
		ipcns_owner.cfi_jt = . + 0x382e0;
		vns_cgroupns_owner.cfi_jt = . + 0x382e8;
		vns_timens_owner.cfi_jt = . + 0x382f0;
		utsns_get.cfi_jt = . + 0x382f8;
		pidns_get.cfi_jt = . + 0x38300;
		pidns_for_children_get.cfi_jt = . + 0x38308;
		userns_get.cfi_jt = . + 0x38310;
		ipcns_get.cfi_jt = . + 0x38318;
		vns_cgroupns_get.cfi_jt = . + 0x38320;
		vns_timens_get.cfi_jt = . + 0x38328;
		vns_timens_for_children_get.cfi_jt = . + 0x38330;
		init_module.cfi_jt = . + 0x38338;
		shadow_hook_inflight_count.cfi_jt = . + 0x38340;
		shadow_hijack_init.cfi_jt = . + 0x38348;
		shadow_ns_init.cfi_jt = . + 0x38350;
		shadow_sysvipc_is_active.cfi_jt = . + 0x38358;
		shadow_sysvipc_init.cfi_jt = . + 0x38360;
		shadow_mqueue_is_active.cfi_jt = . + 0x38368;
		shadow_mqueue_init.cfi_jt = . + 0x38370;
		shadow_cgdevices_is_active.cfi_jt = . + 0x38378;
		shadow_cgdevices_init.cfi_jt = . + 0x38380;
		vendor_kernel_init.cfi_jt = . + 0x38388;
		cleanup_module.cfi_jt = . + 0x38390;
		shadow_hijack_exit.cfi_jt = . + 0x38398;
		shadow_ns_exit.cfi_jt = . + 0x383a0;
		shadow_sysvipc_exit.cfi_jt = . + 0x383a8;
		shadow_mqueue_exit.cfi_jt = . + 0x383b0;
		shadow_cgdevices_exit.cfi_jt = . + 0x383b8;
		vendor_kernel_exit.cfi_jt = . + 0x383c0;
		hotreload_hook_finit_module.cfi_jt = . + 0x383c8;
		shadow_ns_hook_vfork.cfi_jt = . + 0x383d0;
		shadow_ns_hook_fork.cfi_jt = . + 0x383d8;
		shadow_ns_hook_clone3.cfi_jt = . + 0x383e0;
		shadow_ns_hook_clone.cfi_jt = . + 0x383e8;
		shadow_ns_hook_setns.cfi_jt = . + 0x383f0;
		shadow_ns_hook_unshare.cfi_jt = . + 0x383f8;
		shadow_ns_hook_newuname.cfi_jt = . + 0x38400;
		shadow_ns_hook_setdomainname.cfi_jt = . + 0x38408;
		shadow_ns_hook_sethostname.cfi_jt = . + 0x38410;
		shadow_ns_hook_pidfd_open.cfi_jt = . + 0x38418;
		shadow_ns_hook_rt_tgsigqueueinfo.cfi_jt = . + 0x38420;
		shadow_ns_hook_rt_sigqueueinfo.cfi_jt = . + 0x38428;
		shadow_ns_hook_ptrace.cfi_jt = . + 0x38430;
		shadow_ns_hook_getsid.cfi_jt = . + 0x38438;
		shadow_ns_hook_getpgid.cfi_jt = . + 0x38440;
		shadow_ns_hook_setpgid.cfi_jt = . + 0x38448;
		shadow_ns_hook_exit_group.cfi_jt = . + 0x38450;
		shadow_ns_hook_waitid.cfi_jt = . + 0x38458;
		shadow_ns_hook_wait4.cfi_jt = . + 0x38460;
		shadow_ns_hook_tkill.cfi_jt = . + 0x38468;
		shadow_ns_hook_tgkill.cfi_jt = . + 0x38470;
		shadow_ns_hook_kill.cfi_jt = . + 0x38478;
		shadow_ns_hook_getppid.cfi_jt = . + 0x38480;
		shadow_ns_hook_getpid.cfi_jt = . + 0x38488;
		shadow_ns_hook_getresgid.cfi_jt = . + 0x38490;
		shadow_ns_hook_getresuid.cfi_jt = . + 0x38498;
		shadow_ns_hook_getegid.cfi_jt = . + 0x384a0;
		shadow_ns_hook_getgid.cfi_jt = . + 0x384a8;
		shadow_ns_hook_geteuid.cfi_jt = . + 0x384b0;
		shadow_ns_hook_getuid.cfi_jt = . + 0x384b8;
		shadow_ns_hook_pread64.cfi_jt = . + 0x384c0;
		shadow_ns_hook_read.cfi_jt = . + 0x384c8;
		shadow_ns_hook_getdents64.cfi_jt = . + 0x384d0;
		shadow_ns_hook_readlink.cfi_jt = . + 0x384d8;
		shadow_ns_hook_readlinkat.cfi_jt = . + 0x384e0;
		shadow_ns_hook_open.cfi_jt = . + 0x384e8;
		shadow_ns_hook_openat.cfi_jt = . + 0x384f0;
		shadow_ns_hook_openat2.cfi_jt = . + 0x384f8;
		svipc_hook_shmdt.cfi_jt = . + 0x38500;
		svipc_hook_shmat.cfi_jt = . + 0x38508;
		svipc_hook_shmctl.cfi_jt = . + 0x38510;
		svipc_hook_shmget.cfi_jt = . + 0x38518;
		svipc_hook_semtimedop.cfi_jt = . + 0x38520;
		svipc_hook_semop.cfi_jt = . + 0x38528;
		svipc_hook_semctl.cfi_jt = . + 0x38530;
		svipc_hook_semget.cfi_jt = . + 0x38538;
		svipc_hook_msgrcv.cfi_jt = . + 0x38540;
		svipc_hook_msgsnd.cfi_jt = . + 0x38548;
		svipc_hook_msgctl.cfi_jt = . + 0x38550;
		svipc_hook_msgget.cfi_jt = . + 0x38558;
		hook_sys_mount.cfi_jt = . + 0x38560;
		hook_sys_mq_getsetattr.cfi_jt = . + 0x38568;
		hook_sys_mq_notify.cfi_jt = . + 0x38570;
		hook_sys_mq_timedreceive.cfi_jt = . + 0x38578;
		hook_sys_mq_timedsend.cfi_jt = . + 0x38580;
		hook_sys_mq_unlink.cfi_jt = . + 0x38588;
		hook_sys_mq_open.cfi_jt = . + 0x38590;
		vk_hook_mq_getsetattr.cfi_jt = . + 0x38598;
		vk_hook_mq_notify.cfi_jt = . + 0x385a0;
		vk_hook_mq_timedreceive.cfi_jt = . + 0x385a8;
		vk_hook_mq_timedsend.cfi_jt = . + 0x385b0;
		vk_hook_mq_unlink.cfi_jt = . + 0x385b8;
		vk_hook_mq_open.cfi_jt = . + 0x385c0;
		vk_hook_shmctl.cfi_jt = . + 0x385c8;
		vk_hook_shmdt.cfi_jt = . + 0x385d0;
		vk_hook_shmat.cfi_jt = . + 0x385d8;
		vk_hook_shmget.cfi_jt = . + 0x385e0;
		vk_hook_semctl.cfi_jt = . + 0x385e8;
		vk_hook_semtimedop.cfi_jt = . + 0x385f0;
		vk_hook_semop.cfi_jt = . + 0x385f8;
		vk_hook_semget.cfi_jt = . + 0x38600;
		vk_hook_msgctl.cfi_jt = . + 0x38608;
		vk_hook_msgrcv.cfi_jt = . + 0x38610;
		vk_hook_msgsnd.cfi_jt = . + 0x38618;
		vk_hook_msgget.cfi_jt = . + 0x38620;
		vendor_kernel_hook_vfork.cfi_jt = . + 0x38628;
		vendor_kernel_hook_fork.cfi_jt = . + 0x38630;
		vendor_kernel_hook_clone3.cfi_jt = . + 0x38638;
		vendor_kernel_hook_clone.cfi_jt = . + 0x38640;
		vendor_kernel_hook_setns.cfi_jt = . + 0x38648;
		vendor_kernel_hook_unshare.cfi_jt = . + 0x38650;
		free_time_ns.cfi_jt = . + 0x38658;
	}
}
